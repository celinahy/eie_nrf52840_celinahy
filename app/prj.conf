## prj.conf
```kconfig
# Copyright (c) 2021 Nordic Semiconductor ASA
# SPDX-License-Identifier: Apache-2.0
#
# This file contains selected Kconfig options for the application.

CONFIG_GPIO=y
CONFIG_PWM=y
CONFIG_SMF=y

CONFIG_SYSTEM_WORKQUEUE_STACK_SIZE=2048
CONFIG_BT=y
CONFIG_BT_PERIPHERAL=y
CONFIG_BT_DEVICE_NAME="0576 EiE BLE Peripheral"
```

## src/main.c
```c
/*
 * main.c
 */

/* IMPORTS -------------------------------------------------------------------------------------- */

#include <stdio.h>
#include <string.h>
#include <zephyr/bluetooth/bluetooth.h>
#include <zephyr/bluetooth/conn.h>
#include <zephyr/bluetooth/gatt.h>
#include <zephyr/bluetooth/hci.h>
#include <zephyr/bluetooth/uuid.h>
#include <zephyr/device.h>
#include <zephyr/devicetree.h>
#include <zephyr/drivers/display.h>
#include <zephyr/drivers/gpio.h>
#include <zephyr/kernel.h>
#include <zephyr/settings/settings.h>
#include <zephyr/sys/printk.h>

/* MACROS --------------------------------------------------------------------------------------- */

#define BLE_CUSTOM_SERVICE_UUID \
  BT_UUID_128_ENCODE(0x12345678, 0x1234, 0x5678, 0x1234, 0x56789abcdef0)
#define BLE_CUSTOM_CHARACTERISTIC_UUID \
  BT_UUID_128_ENCODE(0x12345678, 0x1234, 0x5678, 0x1234, 0x56789abcdef2)

#define BLE_CUSTOM_CHARACTERISTIC_MAX_DATA_LENGTH 20

/* PROTOTYPES ----------------------------------------------------------------------------------- */

static ssize_t ble_custom_characteristic_read_cb(struct bt_conn *conn, const struct bt_gatt_attr *attr,
                                                 void *buf, uint16_t len, uint16_t offset);
static ssize_t ble_custom_characteristic_write_cb(struct bt_conn *conn, const struct bt_gatt_attr *attr,
                                                  const void *buf, uint16_t len, uint16_t offset,
                                                  uint8_t flags);

/* VARIABLES ------------------------------------------------------------------------------------ */

static const struct bt_uuid_128 ble_custom_service_uuid = BT_UUID_INIT_128(BLE_CUSTOM_SERVICE_UUID);
static const struct bt_uuid_128 ble_custom_characteristic_uuid = BT_UUID_INIT_128(BLE_CUSTOM_CHARACTERISTIC_UUID);

static const struct bt_data ble_advertising_data[] = {
    BT_DATA_BYTES(BT_DATA_FLAGS, (BT_LE_AD_GENERAL | BT_LE_AD_NO_BREDR)),
    BT_DATA_BYTES(BT_DATA_UUID128_ALL, BLE_CUSTOM_SERVICE_UUID),
};

static const struct bt_data ble_scan_response_data[] = {
    BT_DATA(BT_DATA_NAME_COMPLETE, CONFIG_BT_DEVICE_NAME, sizeof(CONFIG_BT_DEVICE_NAME) - 1),
};

static uint8_t ble_custom_characteristic_user_data[BLE_CUSTOM_CHARACTERISTIC_MAX_DATA_LENGTH + 1] = {'H', 'E', 'Y'};;

/* BLE SERVICE SETUP ---------------------------------------------------------------------------- */

BT_GATT_SERVICE_DEFINE(
    ble_custom_service,                                // Name of the struct that will store the config for this service
    BT_GATT_PRIMARY_SERVICE(&ble_custom_service_uuid), // Setting the service UUID

    BT_GATT_CHARACTERISTIC(
        &ble_custom_characteristic_uuid.uuid,   // Setting the characteristic UUID
        BT_GATT_CHRC_READ | BT_GATT_CHRC_WRITE, // Possible operations
        BT_GATT_PERM_READ | BT_GATT_PERM_WRITE, // Permissions that connecting devices have
        ble_custom_characteristic_read_cb,      // Callback for when this characteristic is read from
        ble_custom_characteristic_write_cb,     // Callback for when this characteristic is written to
        ble_custom_characteristic_user_data     // Initial data stored in this characteristic
        ),

    // End of service definition
);

/* FUNCTIONS ------------------------------------------------------------------------------------ */

static ssize_t ble_custom_characteristic_read_cb(struct bt_conn *conn, const struct bt_gatt_attr *attr,
                                                 void *buf, uint16_t len, uint16_t offset)
{
  const char *value = attr->user_data;
  return bt_gatt_attr_read(conn, attr, buf, len, offset, value, strlen(value));
}

static ssize_t ble_custom_characteristic_write_cb(struct bt_conn *conn, const struct bt_gatt_attr *attr,
                                                  const void *buf, uint16_t len, uint16_t offset,
                                                  uint8_t flags)
{
  uint8_t *value_ptr = attr->user_data;

  if (offset + len > BLE_CUSTOM_CHARACTERISTIC_MAX_DATA_LENGTH)
  {
    return BT_GATT_ERR(BT_ATT_ERR_INVALID_OFFSET);
  }

  memcpy(value_ptr + offset, buf, len);
  value_ptr[offset + len] = 0;

  printk(" %s\n", value_ptr);

  return len;
}

/* MAIN ----------------------------------------------------------------------------------------- */

int main(void)
{
  int err = bt_enable(NULL);
  if (err)
  {
    printk("Bluetooth init failed (err %d)\n", err);
    return 0;
  }
  else
  {
    printk("Bluetooth initialized!\n");
  }

  err =
      bt_le_adv_start(BT_LE_ADV_CONN_FAST_1, ble_advertising_data, ARRAY_SIZE(ble_advertising_data),
                      ble_scan_response_data, ARRAY_SIZE(ble_scan_response_data));
  if (err)
  {
    printk("Advertising failed to start (err %d)\n", err);
    return 0;
  }

  while (1)
  {
    k_sleep(K_MSEC(1000));
  }
}
```

## src/my_state_machine.c
```c
/**
 * @file my_state_machine.c
 */

#include <zephyr/smf.h>

#include "LED.h"
#include "my_state_machine.h"

static void led_on_state_entry(void *o);
static enum smf_state_result led_on_state_run(void *o);
static void led_off_state_entry(*void o);
static enum smf_state_result led_off_state_run(void *o);

enum led_state_machine_states
{
    LED_ON_STATE,
    LED_OFF_STATE
};

typedef struct
{
    struct smf_ctx ctx;

    uint16_t count;
} led_state_object_t;

static const struct smf_state led_states[] = {
    [LED_ON_STATE] = SMF_CREATE_STATE(led_on_state_entry, led_on_state_run, NULL, NULL, NULL),
    [LED_OFF_STATE] = SMF_CREATE_STATE(led_off_state_entry, led_off_state_run, NULL, NULL, NULL)};

void state_machine_init()
{
    led_state_object.count = 0;
    smf_set_initial(SMF_CTX(&led_state_object), &led_states[LED_ON_STATE]);
}

int state_machine_run()
{
    return smf_run_state(SMF_CTX(&led_state_object));
}









static void led_on_state_entry(void *o)
{
    LED_set(LED0, LED_ON);
}

static enum smf_state_result led_on_state_run(void *o)
{
    if (led_state_object.count > 500)
    {
        led_state_object.count = 0;
        smf_set_state(SMF_CTX(&led_state_object), &led_states[LED_OFF_STATE]);
    }
    else
    {
        led_state_object.count++;
    }

    return SMF_EVENT_HANDLED;
}

static void led_off_state_entry(void *o)
{
    LED_set(LED0, LED_OFF);
}

static enum smf_state_result led_off_state_run(void *o)
{
    if (led_state_object.count > 500)
    {
        led_state_object.count = 0;
        smf_set_state(SMF_CTX(&led_state_object), &led_states[LED_ON_STATE]);
    }
    else
    {
        led_state_object.count++;
    }

    return SMF_EVENT_HANDLED;
}
```

## src/my_state_machine.h
```c
/**
 *  @file my_state_machine.h
 */

 #ifndef MY_STATE_MACHINE_H
 #define MY_STATE_MACHINE_H

 void state_machine_init();

 int state_machine_run();

 #endif // MY_STATE_MACHINE_H  
```
